#include <input/processors.dtsi>
#include <behaviors/input_gestures_accel.dtsi>

// Конфигурация ускорения для трекбола
&pointer_accel {
    input-type = <INPUT_EV_REL>;
    min-factor = <800>;          // 0.8x на медленных движениях
    max-factor = <3000>;         // 3.0x на быстрых
    speed-threshold = <1200>;    // Порог начала ускорения
    speed-max = <6000>;          // Максимальная скорость
    acceleration-exponent = <2>; // Квадратичная кривая
    track-remainders;            // Отслеживать дробные перемещения
};

#include "charybdis.dtsi"
#include "charybdis_3610.dtsi"
#include "split_input_common.dtsi"

&default_transform {
	col-offset = <6>;
};

&kscan0 {
	compatible = "zmk,kscan-gpio-matrix";
	
	col-gpios
		= <&pro_micro 19 (GPIO_ACTIVE_HIGH | GPIO_PULL_DOWN)>
		, <&pro_micro 20 (GPIO_ACTIVE_HIGH | GPIO_PULL_DOWN)>
		, <&pro_micro 10 (GPIO_ACTIVE_HIGH | GPIO_PULL_DOWN)>
		, <&pro_micro 6 (GPIO_ACTIVE_HIGH | GPIO_PULL_DOWN)>
		, <&pro_micro 7 (GPIO_ACTIVE_HIGH | GPIO_PULL_DOWN)>
		, <&pro_micro 8 (GPIO_ACTIVE_HIGH | GPIO_PULL_DOWN)>
		;

	row-gpios
		= <&pro_micro 18 GPIO_ACTIVE_HIGH>
		, <&pro_micro 5 GPIO_ACTIVE_HIGH>
		, <&pro_micro 4 GPIO_ACTIVE_HIGH>
		, <&pro_micro 9 GPIO_ACTIVE_HIGH>
		;
};

&trackball_split {
    device = <&trackball>;
};
